#include "main.h"
#include "cmsis_os.h"
#include "stepmotor_task.hpp"

extern "C" TIM_HandleTypeDef htim1;

namespace
{
    /*
     * TIM1 runs from the 8 MHz timer clock:
     *   8 MHz / (2 + 1) / (99 + 1) = 26.7 kHz
     *
     * One PWM period is one STEP pulse, so the motor receives
     * approximately 250 revolutions per minute at 6400 pulses/revolution.
     */
    constexpr uint32_t kTimerPrescaler = 2U;
    constexpr uint32_t kTimerPeriod = 99U;
    constexpr uint32_t kStepPulse = 50U;
    constexpr uint32_t kMaxTimerPrescaler = 65535U;
}

extern "C" void stepmotor_set_prescaler(uint32_t prescaler)
{
    if (prescaler > kMaxTimerPrescaler)
    {
        return;
    }

    __HAL_TIM_SET_PRESCALER(&htim1, prescaler);
}

extern "C" void stepmotor_task(void const *argument)
{
    (void)argument;

    /* Keep the initial direction for now; it can be changed later. */
    HAL_GPIO_WritePin(direction_GPIO_Port, direction_Pin, GPIO_PIN_RESET);

    /*
     * Most stepper drivers use an active-low ENABLE input.
     * GPIO_PIN_RESET enables the driver.
     */
    HAL_GPIO_WritePin(enable_GPIO_Port, enable_Pin, GPIO_PIN_RESET);

    __HAL_TIM_SET_PRESCALER(&htim1, kTimerPrescaler);
    __HAL_TIM_SET_AUTORELOAD(&htim1, kTimerPeriod);
    __HAL_TIM_SET_COMPARE(&htim1, TIM_CHANNEL_3, kStepPulse);
    __HAL_TIM_SET_COUNTER(&htim1, 0U);

    if (HAL_TIM_PWM_Start(&htim1, TIM_CHANNEL_3) != HAL_OK)
    {
        /* Stop safely if the timer could not be started. */
        HAL_GPIO_WritePin(enable_GPIO_Port, enable_Pin, GPIO_PIN_SET);
        vTaskSuspend(nullptr);
    }

    while (1)
    {
        /* STEP pulses are generated by TIM1 in hardware. */
        osDelay(1000U);
    }
}
